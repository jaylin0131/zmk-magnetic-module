## boards/shields/magnetic/Kconfig.defconfig
```kconfig
if SHIELD_MAGNETIC

config ZMK_KEYBOARD_NAME
    default "Magnetic"

endif

if ZMK_DISPLAY

config I2C
    default y

config SSD1306
    default y

endif
```

## config/west.yml
```yaml
manifest:
  defaults:
    revision: v0.3
  remotes:
    - name: zmkfirmware
      url-base: https://github.com/zmkfirmware
    - name: zmk-magnetic-module
      url-base: https://github.com/jaylin0131
    - name: mctechnology17
      url-base: https://github.com/mctechnology17
  projects:
    - name: zmk
      remote: zmkfirmware
      import: app/west.yml
    - name: zmk-magnetic-module
      remote: zmk-magnetic-module
      revision: main
    - name: zmk-oled-adapter
      remote: mctechnology17
      revision: main
  self:
    path: config
```
