#include <dt-bindings/zmk/matrix_transform.h>
#include "magnetic_module-layouts.dtsi"

&physical_layout0 {
    kscan = <&kscan0>; // Label of the kscan node this layout uses
    transform = <&default_transform>; // Label of the matrix transform this layout uses
};

/ {

    kscan0: kscan0 {
        compatible = "zmk,kscan-gpio-matrix";
        diode-direction = "col2row";
        wakeup-source;

        col-gpios
            = <&gpio1 0 GPIO_ACTIVE_HIGH>
            , <&gpio0 24 GPIO_ACTIVE_HIGH>
            , <&gpio0 22 GPIO_ACTIVE_HIGH>
            , <&gpio0 20 GPIO_ACTIVE_HIGH>
            , <&gpio0 17  GPIO_ACTIVE_HIGH>
            , <&gpio1 1  GPIO_ACTIVE_HIGH>
            , <&gpio0 8  GPIO_ACTIVE_HIGH>
            , <&gpio1 11  GPIO_ACTIVE_HIGH>
            , <&gpio1 13  GPIO_ACTIVE_HIGH>
            , <&gpio1 15  GPIO_ACTIVE_HIGH>
            , <&gpio0 2  GPIO_ACTIVE_HIGH>
            , <&gpio0 29  GPIO_ACTIVE_HIGH>
            , <&gpio1 6  GPIO_ACTIVE_HIGH>
            , <&gpio1 4  GPIO_ACTIVE_HIGH>
            ;

        row-gpios
            = <&gpio0 6 (GPIO_ACTIVE_HIGH | GPIO_PULL_DOWN)>
            , <&gpio0 11 (GPIO_ACTIVE_HIGH | GPIO_PULL_DOWN)>
            , <&gpio0 31 (GPIO_ACTIVE_HIGH | GPIO_PULL_DOWN)>
            , <&gpio0 9 (GPIO_ACTIVE_HIGH | GPIO_PULL_DOWN)>
            , <&gpio0 1 (GPIO_ACTIVE_HIGH | GPIO_PULL_DOWN)>
            ;
    };


};